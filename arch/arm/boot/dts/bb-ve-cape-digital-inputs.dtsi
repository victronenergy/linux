&am33xx_pinmux {
	digital_inputs: pinmux_digital_inputs {
		pinctrl-single,pins = <
			AM33XX_PADCONF(AM335X_PIN_GPMC_AD14, PIN_INPUT, MUX_MODE7)	/* GPIO1_14 = Digital input 1 */
			AM33XX_PADCONF(AM335X_PIN_GPMC_AD10, PIN_INPUT, MUX_MODE7)	/* GPIO0_26 = Digital input 2 */
			AM33XX_PADCONF(AM335X_PIN_GPMC_CSN0, PIN_INPUT, MUX_MODE7)	/* GPIO1_29 = Digital input 3 */
			AM33XX_PADCONF(AM335X_PIN_GPMC_CLK, PIN_INPUT, MUX_MODE7)	/* GPIO2_1  = Digital input 4 */
			AM33XX_PADCONF(AM335X_PIN_GPMC_AD12, PIN_INPUT, MUX_MODE7)	/* GPIO1_12 = Digital input 5 */
		>;
	};
};
