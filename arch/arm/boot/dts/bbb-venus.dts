/dts-v1/;

#include "am33xx.dtsi"
#include "am335x-bone-common.dtsi"
#include "bb-ve-cape.dtsi"

/ {
	model = "TI AM335x BeagleBone Black with victronenergy cape";
	compatible = "ti,am335x-bone-black", "ti,am33xx";
};

&ldo3_reg {
	regulator-min-microvolt = <1800000>;
	regulator-max-microvolt = <1800000>;
	regulator-always-on;
};

&mmc1 {
	vmmc-supply = <&vmmcsd_fixed>;
};

&mmc2 {
	vmmc-supply = <&vmmcsd_fixed>;
	pinctrl-names = "default";
	pinctrl-0 = <&emmc_pins>;
	bus-width = <8>;
	status = "okay";
};
