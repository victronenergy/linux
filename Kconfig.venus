## Kconfig.venus
```kconfig
# Kconfig doesn't have a counterpart to select for blocking another option.
# Moreover, using "depends on !FOO" leads to illegal recursive dependencies.
# The best we can do is display a warning if a disallowed option is enabled.

config VENUS_BLOCKER
	bool
	default y if WATCHDOG_HANDLE_BOOT_ENABLED
	default y if PANIC_TIMEOUT >= 0

comment "Venus disallowed option(s) enabled"
	depends on VENUS_BLOCKER

config LOCALVERSION
	default "-venus-4"

config VENUS
	bool "Venus defaults"

	# kernel features
	select SYSVIPC
	select POSIX_MQUEUE
	select NO_HZ_IDLE
	select HIGH_RES_TIMERS
	select HIGHMEM
	select BSD_PROCESS_ACCT
	select BSD_PROCESS_ACCT_V3
	select TASKSTATS
	select TASK_DELAY_ACCT
	select TASK_XACCT
	select TASK_IO_ACCOUNTING
	select IRQ_TIME_ACCOUNTING
	select IKCONFIG
	select IKCONFIG_PROC
	select JUMP_LABEL
	select PERF_EVENTS
	select MODULES
	select MODULE_UNLOAD
	select GCC_PLUGINS
	select STACKPROTECTOR
	select STACKPROTECTOR_STRONG
	select STACKPROTECTOR_PER_TASK if SMP

	# cgroups
	select CGROUPS
	select CGROUP_CPUACCT
	select CGROUP_SCHED
	select CFS_BANDWIDTH

	# system options
	select VDSO
	select ARM_ERRATA_430973
	select ARM_ERRATA_643719 if SMP
	select ARM_ERRATA_720789
	select ARM_ERRATA_754322
	select ARM_ERRATA_775420
	select ARM_ERRATA_814220

	# floating-point
	select VFP
	select NEON
	select KERNEL_MODE_NEON

	# memory management
	select COMPACTION
	select CMA
	select DMA_CMA

	# power management
	select PM
	select CPU_FREQ
	select CPU_FREQ_DEFAULT_GOV_PERFORMANCE
	select CPUFREQ_DT
	select CPU_IDLE
	select ARM_CPUIDLE

	# crypto
	select ARM_CRYPTO
	select CRYPTO_SHA1_ARM_NEON
	select CRYPTO_SHA256_ARM
	select CRYPTO_AES_ARM
	select CRYPTO_AES_ARM_BS
	select CRYPTO_CRC32_ARM_CE

	# initrd
	select BLK_DEV
	select BLK_DEV_INITRD
	select RD_GZIP

	# networking
	select INET
	select IPV6
	select IPV6_OPTIMISTIC_DAD
	select IPV6_ROUTER_PREF
	select IPV6_ROUTE_INFO
	select IP_MULTICAST
	select MACVLAN
	select NET
	select NET_CORE
	select NETDEVICES
	select NETFILTER
	select NETFILTER_ADVANCED
	select PACKET
	select UNIX

	# advanced networking (initially only needed by tailscale)
	select IP_ADVANCED_ROUTER
	select IP_MULTIPLE_TABLES
	select IPV6_MULTIPLE_TABLES

	# QoS
	select NET_SCHED
	select NET_CLS_ACT
	select NET_SCH_HTB
	select NET_SCH_INGRESS

	# filesystems
	select CONFIGFS_FS
	select DEVTMPFS
	select DEVTMPFS_MOUNT
	select EXT4_FS
	select EXT4_USE_FOR_EXT2
	select OVERLAY_FS
	select OVERLAY_FS_INDEX
	select OVERLAY_FS_METACOPY
	select OVERLAY_FS_REDIRECT_DIR
	select PROC_FS
	select PROC_SYSCTL
	select TMPFS
	select TMPFS_XATTR
	select SYSFS
	select VFAT_FS
	select NLS_CODEPAGE_437
	select NLS_ISO8859_1
	select NLS_ISO8859_15
	select NLS_UTF8
	select INOTIFY_USER
	select FANOTIFY

	# framebuffer
	select FB
	select FB_VIRTUAL

	# input
	select INPUT
	select INPUT_EVDEV
	select INPUT_KEYBOARD
	select INPUT_MISC
	select INPUT_UINPUT
	select KEYBOARD_GPIO

	# hwmon
	select HWMON

	# leds
	select NEW_LEDS
	select LEDS_CLASS
	select LEDS_GPIO
	select LEDS_PCA963X
	select LEDS_TRIGGERS
	select LEDS_TRIGGER_DEFAULT_ON
	select LEDS_TRIGGER_TIMER
	select LEDS_TRIGGER_SYNC_BLINK

	# misc device options
	select EEPROM_AT24
	select GPIO_PCA953X
	select GPIO_SYSFS

	# mmc
	select MMC
	select MMC_BLOCK

	# thermal
	select THERMAL
	select THERMAL_HWMON
	select THERMAL_OF
	select THERMAL_DEFAULT_GOV_STEP_WISE
	select CPU_THERMAL

	# usb
	select USB_SUPPORT
	select USB
	select USB_ANNOUNCE_NEW_DEVICES
	select USB_MON

	# watchdog
	select WATCHDOG
	select WATCHDOG_NOWAYOUT
	select WATCHDOG_SYSFS

	# debugging
	select DEBUG_BUGVERBOSE
	select DEBUG_FS
	select DEBUG_KERNEL
	select MAGIC_SYSRQ
	select PRINTK_TIME
	select STACKTRACE
	select SOFTLOCKUP_DETECTOR
	select BOOTPARAM_SOFTLOCKUP_PANIC
	select DETECT_HUNG_TASK
	select BOOTPARAM_HUNG_TASK_PANIC
	select WQ_WATCHDOG
	select PANIC_ON_OOPS

config VENUS_MODULES
	def_tristate m if VENUS

	# storage
	select SCSI
	select BLK_DEV_SD
	select USB_STORAGE

	# filesystems
	select EXFAT_FS
	select NTFS3_FS
	select NTFS3_LZX_XPRESS

	# input
	select HID
	select HIDRAW
	select USB_HID

	# misc networking
	select INET_DIAG
	select INET_RAW_DIAG
	select INET_UDP_DIAG
	select NETLINK_DIAG
	select NLMON
	select PACKET_DIAG
	select UNIX_DIAG
	select WIREGUARD
	select TUN

	# netfilter
	select NF_CONNTRACK
	select NF_NAT
	select NETFILTER_NETLINK
	select NETFILTER_XT_CONNMARK
	select NETFILTER_XT_MARK
	select NETFILTER_XT_MATCH_COMMENT
	select NETFILTER_XT_MATCH_CONNTRACK
	select NETFILTER_XT_MATCH_MULTIPORT
	select NETFILTER_XT_TARGET_MASQUERADE
	select IP_NF_IPTABLES
	select IP_NF_FILTER
	select IP_NF_MANGLE
	select IP_NF_NAT
	select IP_NF_TARGET_REJECT
	select IP6_NF_IPTABLES
	select IP6_NF_FILTER
	select IP6_NF_MANGLE
	select IP6_NF_NAT
	select IP6_NF_TARGET_REJECT

	# canbus
	select CAN
	select CAN_RAW
	select CAN_BCM
	select CAN_8DEV_USB
	select CAN_EMS_USB
	select CAN_ESD_USB2
	select CAN_GS_USB
	select CAN_KVASER_USB
	select CAN_MCBA_USB
	select CAN_MCP25XXFD
	select CAN_PEAK_USB
	select CAN_SLCAN
	select CAN_VCAN

	# bluetooth
	select BT
	select BT_LE
	select BT_HCIBTUSB
	select BT_HCIBTUSB_BCM
	select BT_HCIBTUSB_RTL
	select CRYPTO_USER_API_HASH
	select CRYPTO_USER_API_SKCIPHER

	# wifi
	select WLAN
	select CFG80211
	select MAC80211
	select RFKILL
	select WLAN_VENDOR_RALINK
	select RT2X00
	select RT2500USB
	select RT73USB
	select RT2800USB
	select RT2800USB_RT33XX
	select RT2800USB_RT35XX
	select RT2800USB_RT3573
	select RT2800USB_RT53XX
	select RT2800USB_RT55XX
	select RT2800USB_UNKNOWN
	select WLAN_VENDOR_REALTEK
	select RTL8187
	select RTL_CARDS
	select RTL8192CU
	select WLAN_VENDOR_MEDIATEK
	select MT7601U
	select MT76x0U
	select MT76x2U
	select MT7663U
	select MT7663S

	# ppp
	select PPP
	select PPP_BSDCOMP
	select PPP_DEFLATE
	select PPP_ASYNC

	# usb-net
	select USB_NET_DRIVERS
	select USB_USBNET
	select USB_NET_AX8817X
	select USB_NET_AX88179_178A
	select USB_NET_CDCETHER
	select USB_NET_SMSC75XX
	select USB_NET_SMSC95XX

	# usb-serial
	select USB_ACM
	select USB_SERIAL
	select USB_SERIAL_GENERIC
	select USB_SERIAL_SIMPLE
	select USB_SERIAL_ARK3116
	select USB_SERIAL_BELKIN
	select USB_SERIAL_CH341
	select USB_SERIAL_WHITEHEAT
	select USB_SERIAL_DIGI_ACCELEPORT
	select USB_SERIAL_CP210X
	select USB_SERIAL_CYPRESS_M8
	select USB_SERIAL_FTDI_SIO
	select USB_SERIAL_F81232
	select USB_SERIAL_GARMIN
	select USB_SERIAL_MCT_U232
	select USB_SERIAL_MOS7720
	select USB_SERIAL_MOS7840
	select USB_SERIAL_MXUPORT
	select USB_SERIAL_NAVMAN
	select USB_SERIAL_PL2303
	select USB_SERIAL_OTI6858
	select USB_SERIAL_TI
	select USB_SERIAL_XIRCOM
	select USB_SERIAL_OPTION
	select USB_SERIAL_SSU100
	select USB_SERIAL_QT2

	# i2c
	select HID_CP2112
	select I2C_CHARDEV

	# sensors
	select IIO
	select TI_ADS1015
```

## arch/arm/configs/am3517_ccgx_defconfig
```kconfig
CONFIG_EXPERIMENTAL=y
CONFIG_DEFAULT_HOSTNAME="CCGX"
CONFIG_SYSVIPC=y
CONFIG_POSIX_MQUEUE=y
CONFIG_NO_HZ=y
CONFIG_HIGH_RES_TIMERS=y
CONFIG_BSD_PROCESS_ACCT=y
CONFIG_LOG_BUF_SHIFT=16
CONFIG_BLK_DEV_INITRD=y
CONFIG_EXPERT=y
CONFIG_PERF_EVENTS=y
CONFIG_SLAB=y
CONFIG_MODULES=y
CONFIG_MODULE_FORCE_LOAD=y
CONFIG_MODULE_UNLOAD=y
CONFIG_MODULE_FORCE_UNLOAD=y
CONFIG_MODVERSIONS=y
CONFIG_MODULE_SRCVERSION_ALL=y
# CONFIG_BLK_DEV_BSG is not set
CONFIG_PARTITION_ADVANCED=y
CONFIG_ARCH_OMAP=y
CONFIG_OMAP_MUX_DEBUG=y
# CONFIG_MACH_OMAP_GENERIC is not set
# CONFIG_ARCH_OMAP2PLUS_TYPICAL is not set
CONFIG_SOC_HAS_REALTIME_COUNTER=y
# CONFIG_ARCH_OMAP2 is not set
# CONFIG_ARCH_OMAP4 is not set
# CONFIG_SOC_OMAP3430 is not set
# CONFIG_SOC_TI81XX is not set
# CONFIG_SOC_AM33XX is not set
# CONFIG_MACH_OMAP3_BEAGLE is not set
# CONFIG_MACH_DEVKIT8000 is not set
# CONFIG_MACH_OMAP_LDP is not set
# CONFIG_MACH_OMAP3530_LV_SOM is not set
# CONFIG_MACH_OMAP3_TORPEDO is not set
# CONFIG_MACH_OVERO is not set
# CONFIG_MACH_OMAP3EVM is not set
# CONFIG_MACH_OMAP3517EVM is not set
# CONFIG_MACH_OMAP3_PANDORA is not set
# CONFIG_MACH_TOUCHBOOK is not set
# CONFIG_MACH_OMAP_3430SDP is not set
# CONFIG_MACH_NOKIA_RM680 is not set
# CONFIG_MACH_NOKIA_RX51 is not set
# CONFIG_MACH_OMAP_ZOOM2 is not set
# CONFIG_MACH_OMAP_ZOOM3 is not set
# CONFIG_MACH_CM_T35 is not set
# CONFIG_MACH_CM_T3517 is not set
# CONFIG_MACH_IGEP0020 is not set
# CONFIG_MACH_IGEP0030 is not set
# CONFIG_MACH_SBC3530 is not set
# CONFIG_MACH_OMAP_3630SDP is not set
CONFIG_ARM_ERRATA_430973=y
CONFIG_AEABI=y
# CONFIG_OABI_COMPAT is not set
CONFIG_HIGHMEM=y
# CONFIG_COMPACTION is not set
CONFIG_ZBOOT_ROM_TEXT=0x0
CONFIG_ZBOOT_ROM_BSS=0x0
CONFIG_CMDLINE="root=ubi0:rootfs rootfstype=ubifs ubi.mtd=9 mtdparts=omap2-nand.0:512k(MLO),1m(u-boot),256k(env1),256k(env2),1m(u-boot2),256k(bootparms),768k(splash),6m(kernel),200m(data),-(rootfs) omapdss.def_disp=lcd omapfb.vram=0:2M vram=2M fbskip quiet"
CONFIG_CPU_FREQ=y
CONFIG_CPU_FREQ_GOV_POWERSAVE=y
CONFIG_CPU_FREQ_GOV_USERSPACE=y
CONFIG_CPU_FREQ_GOV_ONDEMAND=y
CONFIG_CPU_FREQ_GOV_CONSERVATIVE=y
CONFIG_CPU_IDLE=y
CONFIG_VFP=y
CONFIG_NEON=y
# CONFIG_COREDUMP is not set
# CONFIG_SUSPEND is not set
CONFIG_NET=y
CONFIG_PACKET=y
CONFIG_UNIX=y
CONFIG_XFRM_USER=y
CONFIG_NET_KEY=y
CONFIG_NET_KEY_MIGRATE=y
CONFIG_INET=y
CONFIG_IP_MULTICAST=y
# CONFIG_INET_LRO is not set
CONFIG_IPV6=y
CONFIG_NETFILTER=y
CONFIG_NF_CONNTRACK=m
# CONFIG_NF_CONNTRACK_PROCFS is not set
CONFIG_NF_CT_NETLINK=m
CONFIG_NF_CT_NETLINK_TIMEOUT=m
CONFIG_NETFILTER_XT_TARGET_LOG=m
CONFIG_NETFILTER_XT_MATCH_LIMIT=m
CONFIG_NF_CONNTRACK_IPV4=m
CONFIG_IP_NF_IPTABLES=m
CONFIG_IP_NF_FILTER=m
CONFIG_IP_NF_TARGET_REJECT=m
CONFIG_NF_NAT_IPV4=m
CONFIG_IP_NF_TARGET_MASQUERADE=m
CONFIG_IP_NF_TARGET_NETMAP=m
CONFIG_IP_NF_TARGET_REDIRECT=m
CONFIG_IP_NF_MANGLE=m
CONFIG_IP_NF_TARGET_CLUSTERIP=m
CONFIG_IP_NF_TARGET_ECN=m
CONFIG_IP_NF_TARGET_TTL=m
CONFIG_IP_NF_RAW=m
CONFIG_IP_NF_ARPTABLES=m
CONFIG_IP_NF_ARPFILTER=m
CONFIG_IP_NF_ARP_MANGLE=m
CONFIG_NF_CONNTRACK_IPV6=m
CONFIG_IP6_NF_IPTABLES=m
CONFIG_IP6_NF_FILTER=m
CONFIG_IP6_NF_TARGET_REJECT=m
CONFIG_IP6_NF_MANGLE=m
CONFIG_IP6_NF_RAW=m
CONFIG_NF_NAT_IPV6=m
CONFIG_IP6_NF_TARGET_MASQUERADE=m
CONFIG_IP6_NF_TARGET_NPT=m
CONFIG_DNS_RESOLVER=y
CONFIG_CAN=y
CONFIG_CAN_RAW=y
CONFIG_CAN_TI_HECC=y
CONFIG_BT=m
CONFIG_BT_HCIBTUSB=m
CONFIG_CFG80211=m
CONFIG_LIB80211=y
CONFIG_LIB80211_DEBUG=y
CONFIG_MAC80211=m
CONFIG_RFKILL=y
CONFIG_RFKILL_REGULATOR=y
CONFIG_UEVENT_HELPER_PATH="/sbin/hotplug"
CONFIG_DEVTMPFS=y
CONFIG_CONNECTOR=y
CONFIG_MTD=y
CONFIG_MTD_CMDLINE_PARTS=y
# CONFIG_MTD_OF_PARTS is not set
CONFIG_MTD_CHAR=y
CONFIG_MTD_BLOCK=y
CONFIG_MTD_OOPS=y
CONFIG_MTD_CFI=y
CONFIG_MTD_CFI_INTELEXT=y
CONFIG_MTD_PLATRAM=y
CONFIG_MTD_NAND=y
CONFIG_MTD_NAND_OMAP2=y
CONFIG_MTD_ONENAND=y
CONFIG_MTD_ONENAND_VERIFY_WRITE=y
CONFIG_MTD_ONENAND_OMAP2=y
CONFIG_MTD_UBI=y
CONFIG_BLK_DEV_LOOP=y
CONFIG_BLK_DEV_RAM=y
CONFIG_BLK_DEV_RAM_COUNT=1
CONFIG_BLK_DEV_RAM_SIZE=16384
CONFIG_EEPROM_AT24=y
CONFIG_SCSI=y
# CONFIG_SCSI_PROC_FS is not set
CONFIG_BLK_DEV_SD=y
# CONFIG_SCSI_LOWLEVEL is not set
CONFIG_NETDEVICES=y
CONFIG_MII=y
CONFIG_TUN=y
# CONFIG_NET_VENDOR_BROADCOM is not set
# CONFIG_NET_VENDOR_CHELSIO is not set
# CONFIG_NET_VENDOR_CIRRUS is not set
# CONFIG_NET_VENDOR_FARADAY is not set
# CONFIG_NET_VENDOR_INTEL is not set
# CONFIG_NET_VENDOR_MARVELL is not set
# CONFIG_NET_VENDOR_MICREL is not set
# CONFIG_NET_VENDOR_NATSEMI is not set
# CONFIG_NET_VENDOR_SEEQ is not set
# CONFIG_NET_VENDOR_SMSC is not set
# CONFIG_NET_VENDOR_STMICRO is not set
CONFIG_TI_DAVINCI_EMAC=y
# CONFIG_NET_VENDOR_WIZNET is not set
CONFIG_USB_NET_RNDIS_WLAN=m
CONFIG_RTL8187=m
CONFIG_RT2X00=m
CONFIG_RT2500USB=m
CONFIG_RT73USB=m
CONFIG_RT2800USB=m
CONFIG_RT2800USB_RT53XX=y
CONFIG_RT2800USB_UNKNOWN=y
CONFIG_RTL8192CU=m
# CONFIG_RTLWIFI_DEBUG is not set
# CONFIG_INPUT_MOUSEDEV is not set
CONFIG_INPUT_JOYDEV=y
CONFIG_INPUT_EVDEV=y
CONFIG_KEYBOARD_GPIO=y
# CONFIG_SERIO_SERPORT is not set
CONFIG_VT_HW_CONSOLE_BINDING=y
CONFIG_LEGACY_PTY_COUNT=4
CONFIG_N_GSM=y
CONFIG_SERIAL_8250=y
CONFIG_SERIAL_8250_CONSOLE=y
CONFIG_SERIAL_8250_NR_UARTS=32
CONFIG_SERIAL_8250_EXTENDED=y
CONFIG_SERIAL_8250_MANY_PORTS=y
CONFIG_SERIAL_8250_SHARE_IRQ=y
CONFIG_SERIAL_8250_DETECT_IRQ=y
CONFIG_SERIAL_8250_RSA=y
CONFIG_SERIAL_OMAP=y
CONFIG_SERIAL_OMAP_CONSOLE=y
CONFIG_HW_RANDOM=y
CONFIG_I2C=y
CONFIG_I2C_CHARDEV=y
CONFIG_I2C_OMAP=y
CONFIG_DEBUG_GPIO=y
CONFIG_GPIO_SYSFS=y
# CONFIG_HWMON is not set
CONFIG_WATCHDOG=y
CONFIG_WATCHDOG_CORE=y
CONFIG_WATCHDOG_NOWAYOUT=y
CONFIG_OMAP_WATCHDOG=y
CONFIG_REGULATOR=y
CONFIG_REGULATOR_DUMMY=y
CONFIG_REGULATOR_FIXED_VOLTAGE=y
CONFIG_REGULATOR_TPS65023=y
CONFIG_FB=y
CONFIG_OMAP2_DSS=y
CONFIG_OMAP2_VRAM_SIZE=2
# CONFIG_OMAP2_DSS_DEBUG_SUPPORT is not set
# CONFIG_OMAP2_DSS_VENC is not set
# CONFIG_OMAP2_DSS_SLEEP_AFTER_VENC_RESET is not set
CONFIG_FB_OMAP2=y
CONFIG_PANEL_GENERIC_DPI=y
CONFIG_BACKLIGHT_LCD_SUPPORT=y
CONFIG_LCD_CLASS_DEVICE=y
CONFIG_LCD_PLATFORM=y
CONFIG_BACKLIGHT_CLASS_DEVICE=y
# CONFIG_BACKLIGHT_GENERIC is not set
CONFIG_FRAMEBUFFER_CONSOLE=m
CONFIG_FRAMEBUFFER_CONSOLE_ROTATION=y
CONFIG_FONTS=y
CONFIG_FONT_8x8=y
CONFIG_FONT_8x16=y
CONFIG_USB=y
CONFIG_USB_ANNOUNCE_NEW_DEVICES=y
CONFIG_USB_MON=y
CONFIG_USB_EHCI_HCD=y
CONFIG_USB_MUSB_HDRC=y
CONFIG_USB_MUSB_AM35X=y
CONFIG_USB_ACM=m
CONFIG_USB_TMC=y
CONFIG_USB_STORAGE=y
CONFIG_USB_SERIAL=m
CONFIG_USB_SERIAL_GENERIC=y
CONFIG_USB_SERIAL_CP210X=m
CONFIG_USB_SERIAL_CYPRESS_M8=m
CONFIG_USB_SERIAL_FTDI_SIO=m
CONFIG_USB_SERIAL_GARMIN=m
CONFIG_USB_SERIAL_NAVMAN=m
CONFIG_USB_SERIAL_PL2303=m
CONFIG_USB_SERIAL_OTI6858=m
CONFIG_USB_SERIAL_SIERRAWIRELESS=m
CONFIG_USB_SERIAL_OPTION=m
CONFIG_OMAP_USB2=y
CONFIG_USB_GADGET=y
CONFIG_USB_GADGET_MUSB_HDRC=m
CONFIG_USB_MASS_STORAGE=m
CONFIG_USB_G_SERIAL=m
CONFIG_USB_ULPI=y
CONFIG_NOP_USB_XCEIV=y
CONFIG_MMC=y
CONFIG_MMC_OMAP_HS=y
CONFIG_NEW_LEDS=y
CONFIG_LEDS_CLASS=y
CONFIG_RTC_CLASS=y
CONFIG_RTC_DRV_DS1307=y
CONFIG_DMADEVICES=y
CONFIG_DMA_OMAP=y
# CONFIG_IOMMU_SUPPORT is not set
CONFIG_EXT2_FS=y
CONFIG_EXT3_FS=y
CONFIG_EXT3_FS_POSIX_ACL=y
CONFIG_EXT3_FS_SECURITY=y
CONFIG_EXT4_FS=m
CONFIG_MSDOS_FS=y
CONFIG_VFAT_FS=y
CONFIG_TMPFS=y
CONFIG_UBIFS_FS=y
CONFIG_UBIFS_FS_ADVANCED_COMPR=y
# CONFIG_NETWORK_FILESYSTEMS is not set
CONFIG_NLS_CODEPAGE_437=y
CONFIG_NLS_ISO8859_1=y
CONFIG_PRINTK_TIME=y
# CONFIG_SCHED_DEBUG is not set
CONFIG_PROVE_LOCKING=y
# CONFIG_DEBUG_BUGVERBOSE is not set
# CONFIG_FTRACE is not set
CONFIG_DEBUG_LL=y
CONFIG_EARLY_PRINTK=y
CONFIG_KEYS=y
CONFIG_CRYPTO_CTR=y
CONFIG_CRYPTO_ECB=y
CONFIG_CRYPTO_MICHAEL_MIC=y
CONFIG_CRYPTO_SHA1=y
CONFIG_CRYPTO_ARC4=y
# CONFIG_CRYPTO_ANSI_CPRNG is not set
CONFIG_CRC_CCITT=y
CONFIG_CRC_T10DIF=y
CONFIG_CRC_ITU_T=y
CONFIG_CRC7=y
CONFIG_LIBCRC32C=y
```
